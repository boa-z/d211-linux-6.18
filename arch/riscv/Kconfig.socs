## drivers/video/artinchip/disp/panel/Kconfig
```kconfig
# SPDX-License-Identifier: GPL-2.0-only
choice
	prompt "ArtInChip Panel Drivers"

config AIC_PANEL_RGB_GENERAL
	bool "ArtInChip general RGB panel"
	depends on BACKLIGHT_CLASS_DEVICE && AIC_DISP_RGB
	help
	  ArtInChip general RGB panel
	  A generic driver for RGB panels configured through device tree
	  timings. Use it for panels without a dedicated driver, such as
	  generic 800x480 RGB screens. If unsure, say N.

config AIC_PANEL_LVDS_GENERAL
	bool "ArtInChip general LVDS panel"
	depends on BACKLIGHT_CLASS_DEVICE && AIC_DISP_LVDS
	help
	  ArtInChip general LVDS panel
	  A generic driver for LVDS panels configured through device tree
	  timings. Use it for panels without a dedicated driver.
	  If unsure, say N.

config AIC_PANEL_DSI_SIMPLE
	bool "ArtInChip dsi simale panel driver"
	depends on BACKLIGHT_CLASS_DEVICE && AIC_DISP_MIPI_DSI
	help
	  ArtInChip MIPI DSI simple panel
	  A minimal driver for DSI panels driven purely by device tree
	  sequences. Prefer a dedicated panel driver when one exists.
	  If unsure, say N.

config AIC_PANEL_DSI_NV3051
	bool "ArtInChip dsi panel driver for NV3051"
	depends on BACKLIGHT_CLASS_DEVICE && AIC_DISP_MIPI_DSI
	help
	  Say Y here if you want to enable support for the NV3051 MIPI DSI panel.
	  The driver covers init sequence and backlight handling for this
	  panel. Enable it only on boards wired to an NV3051 screen.

config AIC_PANEL_DSI_GH8555BC
	bool "ArtInChip dsi panel driver for GH8555BC"
	depends on BACKLIGHT_CLASS_DEVICE && AIC_DISP_MIPI_DSI
	help
	  Say Y here if you want to enable support for the GH8555BC MIPI DSI panel.
	  The driver covers init sequence and backlight handling for this
	  panel. Enable it only on boards wired to a GH8555BC screen.

config AIC_PANEL_DSI_B080XAN
	bool "ArtInChip dsi panel driver for B080XAN"
	depends on BACKLIGHT_CLASS_DEVICE && AIC_DISP_MIPI_DSI
	help
	  Say Y here if you want to enable support for the B080XAN
	  768x1024 MIPI DSI panel.
	  The driver covers init sequence and backlight handling for this
	  panel. Enable it only on boards wired to a B080XAN screen.

config AIC_PANEL_SRGB_ILI8961
	bool "ArtInChip srgb panel driver for ILI8961"
	depends on BACKLIGHT_CLASS_DEVICE && AIC_DISP_RGB
	help
	  ArtInChip SRGB ILI8961 panel
	  Driver for ILI8961 based smart RGB panels with init sequence
	  and backlight control. Enable it only on boards wired to an
	  ILI8961 screen.

config AIC_PANEL_DSI_WUXGA_7IN
	bool "ArtInChip panel driver for WUXGA_7IN"
	depends on BACKLIGHT_CLASS_DEVICE && AIC_DISP_MIPI_DSI
	help
	  Say Y here if you want to enable support for the WUXGA_7IN
	  1200x1920 MIPI DSI panel.
	  The driver covers init sequence and backlight handling for this
	  panel. Enable it only on boards wired to such a screen.

config AIC_PANEL_DSI_HX8394_5IN
	bool "ArtInChip panel driver for HX8394_5IN"
	depends on BACKLIGHT_CLASS_DEVICE && AIC_DISP_MIPI_DSI
	help
	  Say Y here if you want to enable support for the HX8394_5IN
	  720x1280 MIPI DSI panel.
	  The driver covers init sequence and backlight handling for this
	  panel. Enable it only on boards wired to such a screen.

config AIC_PANEL_DSI_ST7701S
	bool "ArtInChip dsi panel driver for st7701s"
	depends on BACKLIGHT_CLASS_DEVICE && AIC_DISP_MIPI_DSI
	help
	  Say Y here if you want to enable support for the ST7701S
	  2-lane 480x800 MIPI DSI panel.
	  The driver covers init sequence and backlight handling for this
	  panel. Enable it only on boards wired to an ST7701S screen.

config AIC_PANEL_DSI_TS8224S
	bool "ArtInChip dsi panel driver for ts8224s"
	depends on BACKLIGHT_CLASS_DEVICE && AIC_DISP_MIPI_DSI
	help
	  Say Y here if you want to enable support for the TS8224S(ST7701S)
	  2-lane 480x800 MIPI DSI panel.
	  The driver covers init sequence and backlight handling for this
	  panel. Enable it only on boards wired to a TS8224S screen.

config AIC_PANEL_DSI_XM91080
	bool "ArtInChip dsi panel driver for xm91080"
	depends on BACKLIGHT_CLASS_DEVICE && AIC_DISP_MIPI_DSI
	help
	  Say Y here if you want to enable support for the XM91080
	  1080x1920 MIPI DSI panel.
	  The driver covers init sequence and backlight handling for this
	  panel. Enable it only on boards wired to an XM91080 screen.

config AIC_PANEL_DSI_ILI9881C
	bool "ArtInChip dsi panel driver for ili9881c"
	depends on BACKLIGHT_CLASS_DEVICE && AIC_DISP_MIPI_DSI
	help
	  Say Y here if you want to enable support for the ili9881c
	  800x1280 MIPI DSI panel.
	  The driver covers init sequence and backlight handling for this
	  panel. Enable it only on boards wired to an ILI9881C screen.

config AIC_PANEL_DSI_S070WV20
	bool "ArtInChip dsi panel driver for s070wv20"
	depends on BACKLIGHT_CLASS_DEVICE && AIC_DISP_MIPI_DSI
	help
	  Say Y here if you want to enable support for the s070wv20
	  800x480 MIPI DSI panel.
	  The driver covers init sequence and backlight handling for this
	  panel. Enable it only on boards wired to an S070WV20 screen.

config AIC_PANEL_DSI_SC7707
	bool "ArtInChip dsi panel driver for sc7707"
	depends on BACKLIGHT_CLASS_DEVICE && AIC_DISP_MIPI_DSI
	help
	  Say Y here if you want to enable support for the sc7707
	  720x1560 MIPI DSI panel.
	  The driver covers init sequence and backlight handling for this
	  panel. Enable it only on boards wired to an SC7707 screen.

config AIC_PANEL_DBI_ILI9486L
	bool "ArtInChip dbi panel driver for ILI9486L"
	depends on BACKLIGHT_CLASS_DEVICE && AIC_DISP_MIPI_DBI
	help
	  ArtInChip MIPI DBI Type B (I8080) panel driver for ILI9486L
	  Driver with init sequence and backlight handling for ILI9486L
	  based DBI panels. Enable it only on boards wired to such
	  a screen.

config AIC_PANEL_DBI_ILI9488
	bool "ArtInChip dbi panel driver for ILI9488"
	depends on BACKLIGHT_CLASS_DEVICE && AIC_DISP_MIPI_DBI
	help
	  ArtInChip MIPI DBI Type B (I8080) panel driver for ILI9488
	  Driver with init sequence and backlight handling for ILI9488
	  based DBI panels. Enable it only on boards wired to such
	  a screen.

config AIC_PANEL_DBI_ILI9341
	bool "ArtInChip dbi panel driver for ILI9341"
	depends on BACKLIGHT_CLASS_DEVICE && AIC_DISP_MIPI_DBI
	help
	  ArtInChip MIPI DBI Type C (SPI) panel driver for ILI9341
	  Driver with init sequence and backlight handling for ILI9341
	  based DBI panels. Enable it only on boards wired to such
	  a screen.

config AIC_PANEL_DBI_ST77903
	bool "ArtInChip dbi panel driver for ST77903"
	depends on BACKLIGHT_CLASS_DEVICE && AIC_DISP_MIPI_DBI
	help
	  ArtInChip MIPI DBI Type C (SPI) panel driver for ST77903
	  Driver with init sequence and backlight handling for ST77903
	  based DBI panels. Enable it only on boards wired to such
	  a screen.

endchoice
```

## drivers/video/artinchip/ge/Kconfig
```kconfig
config ARTINCHIP_GE
	tristate "ArtInChip 2D Graphics Engine"
	default n
	help
	  This is a 2D Graphics Engine driver
	  It accelerates fill, blit, rotate and scaler operations for the
	  display stack through the GE hardware block. Enable it on boards
	  that use the ArtInChip framebuffer.
choice
	prompt "select 2D Graphics Engine Mode"
	default ARTINCHIP_GE_NORMAL
	depends on ARTINCHIP_GE

config ARTINCHIP_GE_CMDQ
	bool "CMD queue mode"
	help
	  Enable CMD Queue
	  Command queue mode batches GE jobs for lower CPU overhead.
	  It needs firmware support in the GE block; keep normal mode
	  unless the board validates queue mode.

config ARTINCHIP_GE_NORMAL
	bool "normal mode"
	help
	  Disable CMD Queue
	  Normal mode submits GE jobs one by one from the driver.
	  This is the validated default; use it unless CMD queue mode
	  is explicitly required.

endchoice

if ARTINCHIP_GE
config CTRL_GE_CLK_IN_FRAME
	bool "ArtInChip GE Clock Ctrl In Frames"
	default n
	help
	  This is a GE Clock Ctrl in frames
	  It gates the GE clock between frames to save power.
	  Enable it on battery powered designs; leave it off when
	  validating GE throughput.
endif
```

## drivers/video/artinchip/ve/Kconfig
```kconfig
# SPDX-License-Identifier: GPL-2.0-only
config ARTINCHIP_VE
        tristate "ArtInChip Video Engine Driver"
        default n
	help
	  This is the driver for the ArtInChip VE, the driver
	  for hw video codec embedded in ArtInChip SOCs.
	  It exposes the video engine through a char device for
	  encode and decode offload. Enable it on boards that use
	  hardware video codec.
```
