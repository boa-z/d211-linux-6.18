## arch/riscv/Kconfig.socs
```kconfig
menu "SoC selection"

config ARCH_ANDES
	bool "Andes SoCs"
	depends on MMU && !XIP_KERNEL
	select ERRATA_ANDES
	help
	  This enables support for Andes SoC platform hardware.

config ARCH_ARTINCHIP
	bool "ArtInChip RISC-V SoCs"
	depends on MMU && !XIP_KERNEL
	select ARCH_HAS_RESET_CONTROLLER
	select ERRATA_THEAD
	select RISCV_SBI_CPUIDLE if CPU_IDLE && RISCV_SBI
	help
	  This enables support for ArtInChip RISC-V SoC platform hardware,
	  including the D211 series SoCs.

config MACH_D211
	bool "ArtInChip D211x SoCs support"
	depends on ARCH_ARTINCHIP
	default y
	help
	  This enables support for the ArtInChip D211x series SoCs.

config DEBUG_ON_FPGA_BOARD_ARTINCHIP
	bool "Debug on ArtInChip FPGA board"
	depends on ARCH_ARTINCHIP
	default n
	help
	  Say Y here if the kernel is running on an ArtInChip FPGA board.

config ARCH_ESWIN
	bool "ESWIN SoCs"
	help
	  This enables support for ESWIN SoC platform hardware,
	  including the ESWIN EIC7700 SoC.

config ARCH_MICROCHIP_POLARFIRE
	def_bool ARCH_MICROCHIP

config ARCH_MICROCHIP
	bool "Microchip SoCs"
	help
	  This enables support for Microchip SoC platforms.

config ARCH_RENESAS
	bool "Renesas RISC-V SoCs"
	help
	  This enables support for the RISC-V based Renesas SoCs.

config ARCH_SIFIVE
	bool "SiFive SoCs"
	select ERRATA_SIFIVE if !XIP_KERNEL
	help
	  This enables support for SiFive SoC platform hardware.

config ARCH_SOPHGO
	bool "Sophgo SoCs"
	help
	  This enables support for Sophgo SoC platform hardware.

config ARCH_SPACEMIT
	bool "SpacemiT SoCs"
	select PINCTRL
	help
	  This enables support for SpacemiT SoC platform hardware.

config ARCH_STARFIVE
	def_bool SOC_STARFIVE

config SOC_STARFIVE
	bool "StarFive SoCs"
	select PINCTRL
	select RESET_CONTROLLER
	select ARM_AMBA
	help
	  This enables support for StarFive SoC platform hardware.

config ARCH_SUNXI
	bool "Allwinner sun20i SoCs"
	depends on MMU && !XIP_KERNEL
	select ERRATA_THEAD
	select SUN4I_TIMER
	help
	  This enables support for Allwinner sun20i platform hardware,
	  including boards based on the D1 and D1s SoCs.

config ARCH_THEAD
	bool "T-HEAD RISC-V SoCs"
	depends on MMU && !XIP_KERNEL
	select ERRATA_THEAD
	select PM_GENERIC_DOMAINS if PM
	help
	  This enables support for the RISC-V based T-HEAD SoCs.

config ARCH_VIRT
	bool "QEMU Virt Machine"
	select POWER_RESET
	select POWER_RESET_SYSCON
	select POWER_RESET_SYSCON_POWEROFF
	select GOLDFISH
	select RTC_DRV_GOLDFISH if RTC_CLASS
	select PM_GENERIC_DOMAINS if PM
	select PM_GENERIC_DOMAINS_OF if PM && OF
	select RISCV_SBI_CPUIDLE if CPU_IDLE && RISCV_SBI
	help
	  This enables support for QEMU Virt Machine.

config ARCH_CANAAN
	bool "Canaan Kendryte SoC"
	help
	  This enables support for Canaan Kendryte series SoC platform hardware.

config SOC_CANAAN_K210
	bool "Canaan Kendryte K210 SoC"
	depends on !MMU && ARCH_CANAAN
	select ARCH_HAS_RESET_CONTROLLER
	select PINCTRL
	select COMMON_CLK
	help
	  This enables support for Canaan Kendryte K210 SoC platform hardware.

endmenu # "SoC selection"
```

## drivers/clk/artinchip/Kconfig
```kconfig
# SPDX-License-Identifier: GPL-2.0-only

config CLK_ARTINCHIP
	bool "Clock driver for Artinchip SoC"
	depends on ARCH_ARTINCHIP
	default y
	help
	  Clock driver for Artinchip SoC.
	  It registers the CMU PLLs, fixed factors and peripheral gates,
	  and is required by every other ArtInChip peripheral driver.
	  If unsure, say Y when building for ArtInChip SoCs.

if CLK_ARTINCHIP
choice
	prompt "Artinchip CMU Drivers"

config CLK_ARTINCHIP_V10
	bool "CMU V1.0 driver"
	depends on MACH_D211
	help
	  For CMU V1.0 of Artinchip SoC.
	  This covers the clock controller found on the D211 series,
	  including the fractional PLL and the display SPI modules.
	  Select it for D211 based boards.
endchoice
endif
```

## drivers/media/platform/artinchip/Kconfig
```kconfig
config VIDEO_ARTINCHIP_DVP
	tristate "ArtInChip Digital Video Port Support"
	depends on VIDEO_DEV && COMMON_CLK && VIDEO_V4L2_SUBDEV_API && HAS_DMA
	depends on ARCH_ARTINCHIP
	select VIDEOBUF2_DMA_CONTIG
	select V4L2_FWNODE
	help
	  This is a V4L2 driver for the ArtInChip DVP V1.0

	  To compile this driver as a module, choose M here: the module
	  will be called aic-dvp.
	  It captures parallel BT656/BT601 video from sensors such as
	  GM7150 and XS9950 into videobuf2 buffers.
```

## drivers/net/wireless/aic8800_usb/aic8800_fdrv/Kconfig
```kconfig
config AIC8800_USB_WLAN_SUPPORT
	tristate "AIC8800 wlan Support"
	help
	  This is support for aic wifi driver.
	  USB transport variant of the AIC8800 WLAN function driver.
	  It needs the firmware loader below and a USB connected
	  AIC8800 part. If unsure, say N.

#choice
#        depends on AIC8800_USB_WLAN_SUPPORT
#        prompt "Select 8800 support platform"
#
#        config PLATFORM_ROCHCHIP
#                bool "PLATFORM_ROCHCHIP"
#                depends on AIC8800_USB_WLAN_SUPPORT
#
#	config PLATFORM_ALLWINNER
#                bool "PLATFORM_ALLWINNER"
#                depends on AIC8800_USB_WLAN_SUPPORT
#
#        config PLATFORM_AMLOGIC
#                bool "PLATFORM_AMLOGIC"
#                depends on AIC8800_USB_WLAN_SUPPORT
#
#        config PLATFORM_UBUNTU
#                bool "PLATFORM_UBUNTU"
#                depends on AIC8800_USB_WLAN_SUPPORT
#
#endchoice
#
#config USE_5G
#	bool "AIC8800 force enable 5G"
#        ---help---
#          This is parameter that force enable 5G.
#
#config HE_FOR_OLD_KERNEL
#	bool "AIC8800 support AX for old kernel"
#        ---help---
#          This is parameter that enable AX for old kernel.

config ONE_TXQ
        bool "Use single netdev TX queue"
        depends on AIC8800_USB_WLAN_SUPPORT
        default n
        help
          Enable single netdev TX queue mode. The driver will select the
          hardware TX queue internally instead of using the kernel's
          multi-queue mechanism. Reduces resource usage by allocating
          fewer TX queues in the firmware.

config RWNX_ROC_DUR_MAX
	int "Maximum Remain on Channel duration (ms)"
	depends on AIC8800_USB_WLAN_SUPPORT
	default 500
	range 100 1000
	help
	  Set the maximum duration for remain on channel operation in milliseconds.
	  This bounds off-channel scan and P2P dwell time. The default
	  suits typical station and AP use; raise it only when scans
	  visibly miss access points.
```

## drivers/net/wireless/aic8800_usb/aic_load_fw/Kconfig
```kconfig
config AIC_LOADFW_SUPPORT
	tristate "AIC8800 Load Firmware Support"
	help
	  This is support for aic load firmware driver.
	  It downloads firmware into the AIC8800 USB part before the
	  WLAN function driver probes. Required together with the USB
	  WLAN driver above. If unsure, say N.
```

## drivers/pinctrl/artinchip/Kconfig
```kconfig
# SPDX-License-Identifier: GPL-2.0-only
if ARCH_ARTINCHIP

config PINCTRL_ARTINCHIP
	bool
	select PINMUX
	select GENERIC_PINCONF
	select GPIOLIB
	select GENERIC_IRQ_CHIP

config PINCTRL_ARTINCHIP_V0_1
	bool "Artinchip pin controller version0.1 device driver"
	depends on OF && ARCH_ARTINCHIP && ARM
	select PINCTRL_ARTINCHIP
	help
	  Enable pinctrl version1 driver for Artinchip SoC.
	  This covers the V0.1 pin controller on ARM based ArtInChip
	  parts. It is unused on RISC-V D211, where V1 applies instead.
	  If unsure, say N.

config PINCTRL_ARTINCHIP_V1
	bool "Artinchip pin controller version1 device driver"
	depends on OF && ARCH_ARTINCHIP && RISCV
	select PINCTRL_ARTINCHIP
	help
	  Enable pinctrl version1 driver for Artinchip SoC.
	  This covers the pin controller on the RISC-V D211 series,
	  including pinmux, pull, drive-strength and GPIO ranges.
	  Required on D211, keep it enabled.

endif
```

## drivers/video/artinchip/disp/Kconfig
```kconfig
# SPDX-License-Identifier: GPL-2.0-only
config ARTINCHIP_FB
	tristate "ArtInChip Framebuffer support"
	depends on FB
	select VIDEOMODE_HELPERS
	select FB_CFB_FILLRECT
	select FB_CFB_COPYAREA
	select FB_CFB_IMAGEBLIT
	default n
	help
          This is the driver for the ArtInChip DE, the driver is based on
	  Linux framebuffer.
	  It drives RGB/LVDS/DSI/DBI panels through the display engine
	  with GE 2D acceleration. Enable it on boards with a screen,
	  and pick the matching output and panel options below.

config AIC_DISP_RGB
	bool "ArtInChip display rgb support"
	depends on ARTINCHIP_FB
	default n
	help
	  ArtInChip display rgb support
	  RGB is the parallel display output used by 800x480 class panels.
	  It requires a matching RGB panel driver
	  from the panel choice below.

config AIC_DISP_LVDS
	bool "ArtInChip display lvds support"
	depends on ARTINCHIP_FB
	default n
	help
	  ArtInChip display lvds support
	  LVDS serializes the RGB output for longer cable runs to the
	  panel. Enable it only with an LVDS panel and matching
	  panel driver selected below.

config AIC_DISP_MIPI_DSI
	bool "ArtInChip display mipi-dsi support"
	depends on ARTINCHIP_FB
	default n
	help
	  ArtInChip display mipi-dsi support
	  MIPI DSI drives smart panels over high speed serial lanes.
	  Pair it with the panel driver matching the connected screen
	  from the panel choice below.

config AIC_DISP_MIPI_DSI_V1_0
	bool
	default y
	depends on AIC_DISP_MIPI_DSI && RISCV
	help
	  ArtInChip display mipi-dsi v1.0

config AIC_DISP_MIPI_DBI
	bool "ArtInChip display mipi-dbi support"
	depends on ARTINCHIP_FB
	default n
	help
	  ArtInChip display mipi-dbi support
	  MIPI DBI (I8080/SPI style) drives small smart panels.
	  Pair it with the panel driver matching the connected screen
	  from the panel choice below.

config AIC_DSI_LEGACY_PACKET
	bool "enable MIPI-DSI legacy packet config"
	depends on AIC_DISP_MIPI_DSI
	default n
	help
	  Choose this option if you have a need for the legacy luban
	  sdk version support. If in doubt, say "N".
	  Legacy packet mode keeps compatibility with first-generation
	  DSI panels. New designs should leave it disabled.

if ARTINCHIP_FB
source "drivers/video/artinchip/disp/panel/Kconfig"
endif
```
